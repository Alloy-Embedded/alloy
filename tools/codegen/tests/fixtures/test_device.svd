# TEST_MCU register map
File version: 1.0
Test MCU for unit tests
CPU: CM3 r2p1, little endian, MPU, no FPU, 4 interrupt priority bits
Registers are 32-bit, access not given, reset 0x0 unless marked. A register's access mark holds for its fields unless they carry their own. Offsets are from the block's base; lines under a group give offsets from that group; [hi:lo] are bit positions; {n}, {i} and the like mark numbered series; 'fields as' and 'values as' point back to an identical list; <NAME> marks a mode.

## Memory map
0x40004400 USART2 — Universal Synchronous Asynchronous Receiver Transmitter 2
0x40010800 GPIOA size 0x400 — General Purpose I/O Port A
0x40010C00 GPIOB size 0x400 — General Purpose I/O Port B
0x40013800 USART1 size 0x400 — Universal Synchronous Asynchronous Receiver Transmitter 1

## Interrupts
37 USART1 — USART1 global interrupt
38 USART2 — USART2 global interrupt

## GPIOA — General Purpose I/O Port A
Base 0x40010800
0x00 CRL rw reset 0x44444444 — Port configuration register low
0x04 CRH rw reset 0x44444444 — Port configuration register high
0x08 IDR ro — Port input data register
0x0C ODR rw — Port output data register

## GPIOB — General Purpose I/O Port B
Base 0x40010C00
0x00 CRL — Port configuration register low
0x04 CRH — Port configuration register high
0x08 IDR — Port input data register
0x0C ODR — Port output data register

## USART1 — Universal Synchronous Asynchronous Receiver Transmitter 1
Base 0x40013800
0x00 SR — Status register
0x04 DR — Data register
0x08 BRR — Baud rate register

## USART2 — Universal Synchronous Asynchronous Receiver Transmitter 2
Base 0x40004400
0x00 SR
0x04 DR
0x08 BRR
